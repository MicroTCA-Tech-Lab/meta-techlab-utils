## conf/distro/microtca-linux.conf
```bitbake
require conf/distro/petalinux.conf

# Remove stuff usually not needed on a MicroTCA board
DISTRO_FEATURES:remove = "alsa bluetooth pcmcia wifi 3g nfc pulseaudio xen virtualization vmsep"

# Remove GUI stuff if the target is a headless system
DISTRO_FEATURES:remove += "${@' fbdev x11 wayland opengl' if d.getVar('HEADLESS') == '1' else ''}"
```

## conf/layer.conf
```bitbake
# We have a conf and classes directory, add to BBPATH
BBPATH .= ":${LAYERDIR}"

# We have recipes-* directories, add to BBFILES
BBFILES += "${LAYERDIR}/recipes-*/*/*.bb \
            ${LAYERDIR}/recipes-*/*/*.bbappend \
            ${LAYERDIR}/packagegroups/*.bb \
"

BBFILE_COLLECTIONS += "meta-techlab-utils"
BBFILE_PATTERN_meta-techlab-utils = "^${LAYERDIR}/"
BBFILE_PRIORITY_meta-techlab-utils = "8"

LAYERDEPENDS_meta-techlab-utils = "core"
LAYERSERIES_COMPAT_meta-techlab-utils = "warrior zeus"

# For fzf we bring our own Go version, since the Yocto 'Zeus' bundled one (1.12) is too old
# Override GOVERSION from tcmode-default.inc to use the newer Go recipes system-wide
GOVERSION = "1.15%"
```
